## boards/arm/rff-light-alarm-v0/Kconfig.board
```kconfig
# STM32 Minimum Development Board Configuration

# Copyright (c) 2017, embedjournal.com
# SPDX-License-Identifier: Apache-2.0

config BOARD_RFF_LIGHT_ALARM_V0
	bool "RFF: board (v0) for light alarm"
	depends on SOC_STM32F103X8
```

## boards/arm/rff-light-alarm-v0/Kconfig.defconfig
```kconfig
# STM32 Minimum Development Board Configuration

# Copyright (c) 2017, embedjournal.com
# SPDX-License-Identifier: Apache-2.0

if BOARD_RFF_LIGHT_ALARM_V0

config BOARD
	default "rff_light_alarm_v0"

if UART_CONSOLE

config UART_1
	default y

endif # UART_CONSOLE

if I2C

config I2C_1
	default y

config I2C_2
	default y

endif # I2C

if PWM

config PWM_STM32_3
	default y

endif # PWM

if SPI

config SPI_1
	default y

config SPI_2
	default y

endif # SPI

endif
```
